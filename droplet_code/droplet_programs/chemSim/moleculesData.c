#include "droplet_programs/chemSim/moleculesData.h"

const uint8_t MOLECULE_LOOKUP[2719] PROGMEM = {
	0X84,0XA,0XD1,0XF8,0X0,0X2,0X8,0X3,0X2,0X48,0X3,0XD4,0X5,0X2,0X48,0X3,0X2,0X7,0X5,0X2,
	0X47,0X3,0XCD,0XFF,0X0,0X5C,0XFF,0X2,0X8,0X3,0X4,0X41,0XB,0X7,0X5,0X80,0XFD,0X0,0X2B,0X5,
	0X2,0XB,0X3,0X4D,0XFB,0X0,0XBD,0XF6,0X2,0X8,0X3,0X23,0X0,0X6,0X41,0X15,0X7,0XD,0X8,0X5,
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	0XE,0XA,0X86,0X38,0X1,0X7,0XF4,0X8,0XE3,0X9,0XBA,0XB,0XA4,0X11,0X33,0X23,0X1B,0X35,0X9
};

uint8_t atom_storage[MAX_NUM_ATOMS_RESULTS];
uint16_t curAtomIndex;

uint8_t num_molecule_results;
uint8_t molecule_count=0;


int16_t _molecule_search(uint8_t* atomIDs, uint8_t atomIDsSize, uint16_t trieIdx, uint8_t hasValFlag)
{
	uint16_t childStartIdx;
	uint8_t numAtomsLeft=0;
	for(uint8_t i=0;i<atomIDsSize;i++) if(atomIDs[i]!=0) numAtomsLeft++;
	if(numAtomsLeft==0)
	{
		if(hasValFlag){
			return pgm_read_word(&(MOLECULE_LOOKUP[trieIdx]));
		}else{
			return 0x7FFF;
		}
	}else{
		if(hasValFlag){
			childStartIdx=trieIdx+2;
		}else{
			childStartIdx=trieIdx;
		}
	}
	uint8_t childDataSize = pgm_read_byte(&(MOLECULE_LOOKUP[childStartIdx]));
	uint8_t i=1;
	while(i<childDataSize){
		uint8_t childKeyByte = pgm_read_byte(&(MOLECULE_LOOKUP[childStartIdx+i]));
		i+=1;
		uint16_t childIdxOffset;
		if(childKeyByte&0x80){
			childIdxOffset = pgm_read_word(&(MOLECULE_LOOKUP[childStartIdx+i]));
			i+=2;
			}else{
			childIdxOffset = pgm_read_byte(&(MOLECULE_LOOKUP[childStartIdx+i]));
			i+=1;
		}
		uint8_t childValFlag;
		if(childKeyByte&0x40){
			childValFlag=0;
			}else{
			childValFlag=1;
		}
		uint8_t childKey = childKeyByte&0x3F;
		uint16_t childIdx = trieIdx-childIdxOffset;
		for(uint8_t j=0;j<atomIDsSize;j++)
		{
			if(atomIDs[j]==childKey){
				//printf("Found match. %hu:%hu\r\n",atomIDs[j],childKey);
				atomIDs[j]=0;
				int16_t deltaG = _molecule_search(atomIDs, atomIDsSize, childIdx, childValFlag);
				if(deltaG!=0x7FFF) return deltaG;
				atomIDs[j]=childKey;
				break;
			}
		}
	}
	return 0x7FFF;
}

uint8_t molecule_search(uint8_t* atoms, int16_t* deltaG, uint8_t numAtoms)
{
	//printf("\tMolecule Search:\t");
	//for(uint8_t i=0;i<numAtoms;i++){
		//printf("%hu ", atoms[i]);
	//}
	//printf("\r\n");
	
	uint16_t rootIdx = pgm_read_word(&(MOLECULE_LOOKUP[0]));
	int16_t result = _molecule_search(atoms, numAtoms, rootIdx, 0);
	*deltaG=result;
	//printf("\t\tGot: %d\r\n", result);
	if(result==0x7FFF)	return 0;
	else				return 1;
}

void _get_molecules(uint8_t* molecule, uint8_t moleculeSize, uint8_t* atomIDs, uint8_t atomIDsSize, uint16_t trieIdx, uint8_t hasValFlag)
{
	if(num_molecule_results>=MAX_NUM_MOLECULE_RESULTS)
	{
		printf_P(PSTR("MAX_NUM_MOLECULE RESULTS exceeded!\r\n"));
		return;
	}
	if(curAtomIndex>=MAX_NUM_ATOMS_RESULTS){
		printf_P(PSTR("MAX_NUM_ATOMS_RESULTS exceeded!\r\n"));
	}
	uint16_t childStartIdx;
	if(hasValFlag){
		results_storage[num_molecule_results].atoms = &(atom_storage[curAtomIndex]);
		for(uint8_t i=0;i<moleculeSize;i++)
		{
			results_storage[num_molecule_results].atoms[i] = molecule[i];
			curAtomIndex++;
			if(curAtomIndex>=MAX_NUM_ATOMS_RESULTS){
				printf_P(PSTR("MAX_NUM_ATOMS_RESULTS exceeded!\r\n"));
			}
		}
		results_storage[num_molecule_results].numAtoms = moleculeSize;
		results_storage[num_molecule_results].deltaG = pgm_read_word(&(MOLECULE_LOOKUP[trieIdx]));
		num_molecule_results++;
		childStartIdx=trieIdx+2;
		}else{
		childStartIdx=trieIdx;
	}
	uint8_t numAtomsLeft=0;
	for(uint8_t i=0;i<atomIDsSize;i++) if(atomIDs[i]!=0) numAtomsLeft++;
	if(numAtomsLeft==0) return;
	uint8_t childDataSize = pgm_read_byte(&(MOLECULE_LOOKUP[childStartIdx]));
	uint8_t i=1;
	while(i<childDataSize){
		uint8_t childKeyByte = pgm_read_byte(&(MOLECULE_LOOKUP[childStartIdx+i]));
		i+=1;
		uint16_t childIdxOffset;
		if(childKeyByte&0x80){
			childIdxOffset = pgm_read_word(&(MOLECULE_LOOKUP[childStartIdx+i]));
			i+=2;
			}else{
			childIdxOffset = pgm_read_byte(&(MOLECULE_LOOKUP[childStartIdx+i]));
			i+=1;
		}
		uint8_t childValFlag;
		if(childKeyByte&0x40){
			childValFlag=0;
			}else{
			childValFlag=1;
		}
		uint8_t childKey = childKeyByte&0x3F;
		uint16_t childIdx = trieIdx-childIdxOffset;
		for(uint8_t j=0;j<atomIDsSize;j++)
		{
			if(atomIDs[j]==childKey){
				//printf("Found match. %hu:%hu\r\n",atomIDs[j],childKey);
				atomIDs[j]=0;
				molecule[moleculeSize]=childKey;
				_get_molecules(molecule, moleculeSize+1, atomIDs, atomIDsSize, childIdx, childValFlag);
				atomIDs[j]=childKey;
				break;
			}
		}
	}
}

uint8_t checkMake(uint8_t* atomSet, uint8_t atomSetSize, uint8_t* molecule, uint8_t moleculeSize)
{
	//printf("Checking make for: (");
	//for(uint8_t i=0;i<moleculeSize;i++) printf("%hu ", molecule[i]);
	//printf(") with atomSet (");
	//for(uint8_t i=0;i<atomSetSize;i++) if(atomSet[i]!=0) printf("%hu ", atomSet[i]);
	//printf(")\r\n");
	
	int8_t i;
	for(i=0;i<moleculeSize;i++){
		uint8_t found=0;
		for(uint8_t j=0;j<atomSetSize;j++){
			if(atomSet[j]==molecule[i]){
				found=1;
				atomSet[j]=0;
				break;
			}
		}
		if(!found){
			return 0;
		}
	}
	return 1;
}

//Returns index into array results_storage where the best set of products is
uint8_t getBest(uint8_t* atoms, uint8_t numAtoms, uint8_t* bestMoleculeSet)
{
	uint8_t curNumAtoms=0;
	for(uint8_t i=0;i<numAtoms;i++){
		if(atoms[i]!=0) curNumAtoms++;
	}
	if(curNumAtoms==0){
		return 0;
	}
	uint8_t atoms_copy[numAtoms];
	for(uint8_t i=0;i<numAtoms;i++) atoms_copy[i]=atoms[i];
	for(uint8_t i=0;i<num_molecule_results;i++)
	{
		uint8_t numAtomsInMolecule = results_storage[i].numAtoms;
		if(checkMake(atoms, numAtoms, results_storage[i].atoms, numAtomsInMolecule)){
			uint8_t idx = getBest(atoms, numAtoms, bestMoleculeSet);
			bestMoleculeSet[idx] = i;
			return idx+1;
		}else{
			for(uint8_t j=0;j<numAtoms;j++) atoms[j]=atoms_copy[j];
		}
	}
}

uint8_t get_molecules(uint8_t* atoms, uint8_t* bestMoleculeSet, uint8_t numAtoms)
{
	uint8_t molecule_arr[12];
	uint16_t rootIdx = pgm_read_word(&(MOLECULE_LOOKUP[0]));
	num_molecule_results=0;
	curAtomIndex=0;
	num_molecule_results=0;	
	_get_molecules(molecule_arr, 0, atoms, numAtoms, rootIdx, 0);
	qsort(results_storage,num_molecule_results,sizeof(molecule_result),comp_func);
	//for(uint8_t i=0;i<num_molecule_results;i++)
	//{
	//uint8_t numMoleculeAtoms = results_storage[i].numAtoms;
	//printf("(");
	//for(uint8_t j=0;j<numMoleculeAtoms;j++) printf("%hu ", results_storage[i].atoms[j]);
	//printf("): %d\r\n", results_storage[i].deltaG);
	//}
	uint8_t numBest = getBest(atoms, numAtoms, bestMoleculeSet);
	return numBest;
}